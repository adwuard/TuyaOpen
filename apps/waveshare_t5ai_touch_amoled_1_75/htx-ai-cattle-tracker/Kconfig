## apps/waveshare_t5ai_touch_amoled_1_75/htx-ai-cattle-tracker/Kconfig
```kconfig
menu "configure app (htx-ai-cattle-tracker) "

config TUYA_PRODUCT_ID
    string "product ID of project"
    default "awtowrksuozwqqmx"

choice 
    prompt "choose chat mode"
    default ENABLE_CHAT_MODE_ASR_WAKEUP_FREE

    config ENABLE_CHAT_MODE_KEY_PRESS_HOLD_SINGEL
    bool "press and hold button to start a single conversation."   

    config ENABLE_CHAT_MODE_KEY_TRIG_VAD_FREE
    bool "press the button once to start or stop the free conversation."

    config ENABLE_CHAT_MODE_ASR_WAKEUP_SINGEL
    bool "say the wake-up word to initiate a single conversation, similar to a smart speaker."  

    config ENABLE_CHAT_MODE_ASR_WAKEUP_FREE
    bool "saying the wake-up word, you can have a free conversation."  
endchoice

if(ENABLE_CHAT_MODE_ASR_WAKEUP_SINGEL || ENABLE_CHAT_MODE_ASR_WAKEUP_FREE)
    choice    
        prompt "choose wakeup keyword"
        default ENABLE_WAKEUP_KEYWORD_NIHAO_TUYA

        config ENABLE_WAKEUP_KEYWORD_NIHAO_TUYA
        bool "the wake-up word is configured as NI HAO TUYA."   
    
        config ENABLE_WAKEUP_KEYWORD_NIHAO_XIAOZHI
        bool "the wake-up word is configured as NI HAO XIAO ZHI."   

        config ENABLE_WAKEUP_KEYWORD_XIAOZHI_TONGXUE
        bool "the wake-up word is configured as XIAO ZHI TONG XUE."  
    
        config ENABLE_WAKEUP_KEYWORD_XIAOZHI_GUANJIA
        bool "the wake-up word is configured as XIAO ZHI GUAN JIA."  
    endchoice
endif

config ENABLE_CHAT_DISPLAY
    bool "enable the display module"
    default n

    if (ENABLE_CHAT_DISPLAY)
        rsource "./src/display/Kconfig"
    endif

config ENABLE_BMM150_SENSOR
    bool "enable BMM150 magnetometer sensor (DEPRECATED - use BNO08X instead)"
    default n
    help
        Enable BMM150 3-axis magnetometer for compass heading.
        DEPRECATED: This sensor has been replaced by BNO08X IMU.

config ENABLE_GPS_LC76G
    bool "enable LC76G GPS module"
    default y
    help
        Enable LC76G GPS module for location tracking

if ENABLE_GPS_LC76G
    choice GPS_INTERFACE_TYPE
        prompt "GPS Interface Type"
        default CONFIG_USE_GPS_I2C
        help
            Select the communication interface for GPS module

        config CONFIG_USE_GPS_I2C
            bool "I2C Interface"
            help
                Use I2C interface for GPS communication (default)

        config CONFIG_USE_GPS_UART
            bool "UART Interface"
            help
                Use UART interface for GPS communication
    endchoice

    config GPS_I2C_SCL_PIN
        int "GPS I2C SCL pin"
        default 20
        range 0 63
        depends on CONFIG_USE_GPS_I2C
        help
            GPIO pin for GPS I2C SCL (shared with touch display)

    config GPS_I2C_SDA_PIN
        int "GPS I2C SDA pin"
        default 21
        range 0 63
        depends on CONFIG_USE_GPS_I2C
        help
            GPIO pin for GPS I2C SDA (shared with touch display)

    config GPS_UART_PORT
        int "GPS UART Port Number (0-5)"
        default 2
        range 0 5
        depends on CONFIG_USE_GPS_UART
        help
            Select UART port number for GPS module

    config GPS_UART_TX_PIN
        int "GPS UART TX pin"
        default 41
        range 0 63
        depends on CONFIG_USE_GPS_UART
        help
            GPIO pin for UART TX (P41 for UART2_TX)

    config GPS_UART_RX_PIN
        int "GPS UART RX pin"
        default 40
        range 0 63
        depends on CONFIG_USE_GPS_UART
        help
            GPIO pin for UART RX (P40 for UART2_RX)

    config GPS_UART_BAUDRATE
        int "GPS UART Baudrate"
        default 115200
        depends on CONFIG_USE_GPS_UART
        help
            Baudrate for UART communication with GPS module (LC76G default: 115200)

    config LC76G_ENABLE_NMEA_LOGS
        bool "Enable detailed NMEA sentence parsing logs"
        default n
        help
            Enable detailed NMEA sentence parsing logs for debugging GPS communication.
            When enabled, shows individual field values from each NMEA sentence type
            including GGA, RMC, VTG, GSA, and GSV sentences. This generates verbose
            log output useful for GPS troubleshooting and development.
endif

config ENABLE_ENCODER_INPUT
    bool "enable rotary encoder input"
    default y
    select ENABLE_ENCODER
    help
        Enable rotary encoder for user input (rotation and button press detection)
        
config ENABLE_ENCODER_DRIVER
    bool
    default y if ENABLE_ENCODER_INPUT

if ENABLE_ENCODER_INPUT
    config DECODER_INPUT_A
        int "encoder A signal pin (clockwise detection)"
        range 0 63
        default 16
        help
            GPIO pin for encoder A signal (quadrature input).
            This pin detects clockwise rotation when combined with B signal.

    config DECODER_INPUT_B
        int "encoder B signal pin (counter-clockwise detection)"
        range 0 63
        default 17
        help
            GPIO pin for encoder B signal (quadrature input).
            This pin detects counter-clockwise rotation when combined with A signal.

    config DECODER_INPUT_P
        int "encoder button press detection pin"
        range 0 63
        default 47
        help
            GPIO pin for encoder button/press detection.
            Active low - reads LOW when button is pressed.
endif

config ENABLE_CATTLE_TRACKER_UI
    bool "enable Cattle AI Tracker UI (alternative UI)"
    default y
    depends on ENABLE_CHAT_DISPLAY
    help
        Enable the Cattle AI Tracker UI as an alternative to the default chat UI.
        This provides a compass/GPS-based tracking interface.

config ENABLE_CELLULAR_SUPPORT
    bool "enable cellular support"
    default n
    select ENABLE_CELLULAR if ENABLE_CELLULAR_SUPPORT
    help
        Enable app hardware capability configuration including cellular network functionality.
        This enables 4G/LTE connectivity. Disable this if you only need WiFi connectivity.

config ENABLE_CLOUD_API
    bool "enable cloud API for cattle location query"
    default y
    help
        Enable cloud API functionality for querying cattle location data from Tuya IoT platform.
        This allows the tracker to fetch real-time cattle position information from the cloud.
        Disable this if you only need local GPS tracking without cloud integration.

config ENABLE_BATTERY
    bool "enable battery"
    default y
    help
        Enable battery voltage monitoring and status reporting functionality.
        This includes battery level detection, charging status, and low battery warnings.

config ENABLE_DEBUG_VIRTUAL_SIMULATION
    bool "enable debug virtual simulation mode"
    default n
    help
        Enable virtual simulation mode for debugging and testing purposes.
        Note: This should be disabled in production builds.

config ENABLE_BNO08X_SENSOR
    bool "enable BNO08x IMU sensor"
    default y
    help
        Enable BNO08x IMU sensor for heading, pitch, and roll detection.
        This sensor is used for compass heading and orientation tracking.

endmenu
```
